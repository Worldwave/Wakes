## Kconfig
```
# wakes-sp1 application Kconfig.

menu "wakes-sp1"

# ---- the USB device's identity (M5a, src/sp1_usbd.c) ----
# Through M4e the console came up through Zephyr's sample helper, which hard-codes Zephyr's
# shared test vendor ID. These are ours. ⚠️ Change the PID whenever the set of USB functions
# changes (M5a added MIDI): hosts cache descriptors by VID/PID.
config SP1_USB_VID
	hex "USB vendor ID"
	default 0x2fe3
	help
	  0x2fe3 is Zephyr's test vendor ID, kept only until pid.codes (VID 0x1209,
	  free product IDs for open-source projects) grants Wakes a PID of its own.

config SP1_USB_PID
	hex "USB product ID"
	default 0x5213
	help
	  0x5211 through M4e (console only); 0x5212 from M5a (console + MIDI);
	  0x5213 from M5c (console + MIDI + audio out). Interim: pid.codes
	  1209:4440 is requested (pidcodes/pidcodes.github.com#1301).

config SP1_USB_MANUFACTURER
	string "USB manufacturer string"
	default "Worldwave"

config SP1_USB_PRODUCT
	string "USB product string (the name hosts show for the device and its MIDI port)"
	default "Wakes"
	help
	  "wakes-sp1" through v0.6.x; "Wakes" from M5c (Adara). DAWs remember MIDI routings by
	  port name, so a change means re-selecting the port once on each host.

config SP1_USB_MAX_POWER
	int "bMaxPower, in units of 2 mA"
	default 50
	range 0 250
	help
	  iOS rejects accessories claiming more than 100 mA over the camera adapter, and
	  the SP-1 runs from its own battery.

config SP1_AUDIO_BLOCK_FRAMES
	int "Audio block, in frames at 48 kHz"
	default 96
	range 48 240
	help
	  How much audio is rendered at a time: 96 = 2 ms (the default since #32; with 1 queued,
	  8 ms of latency), 240 = 5 ms (25 ms with 2 queued; v0.5.0). Must be a multiple of 48 (1 ms): whole
	  Plaits blocks, and whole 1 kHz groups for Marbles' X/Y. Latency is
	  (CONFIG_I2S_NRFX_TX_BLOCK_COUNT + 3) blocks -- see prj.conf.

config SP1_PLAITS_BLOCK
	int "Plaits block, in samples (12 or 24)"
	default 24
	range 12 24
	depends on SP1_PLAITS
	help
	  How many samples Plaits renders per call (upstream: 12). 24 (#32) halves Plaits'
	  per-call work and our per-Plaits-block glue; modulation, TRIG and MIDI placement move
	  to a 0.5 ms grid and Marbles runs at 2 kHz instead of 4. Every time constant of ours
	  that counted blocks (the TRIG pulse, Plaits' trigger delay, Additive's spectrum
	  update, Chords' crossfade, MIDI's clock and smoothing, Marbles' rate) is expressed in
	  time, so it is the same at either size. Only 12 and 24 are valid.

config SP1_TRIGGER_DELAY_SAMPLES
	int "Plaits' TRIG delay, in samples (whole Plaits blocks)"
	default 24
	range 0 96
	depends on SP1_PLAITS
	help
	  Upstream Plaits delays its TRIG input by 1 ms (48 samples) so a eurorack pitch CV
	  that lags its gate is still caught. In Wakes every TRIG arrives with its pitch, but
	  Plaits averages its V/Oct input over two blocks, so with no delay a Marbles X -> V/Oct
	  strike catches the pitch half-way (host: Modal's attack -1 dB from the settled one,
	  against -18 dB at 0.5 ms; MIDI notes and the quantizer latch are unaffected even at 0).
	  24 = 0.5 ms keeps every attack as it was (#32). Must be whole Plaits blocks.

config SP1_PROFILE_ICACHE
	bool "Diagnostics: flash-cache misses per audio section"
	default n
	depends on SP1_PLAITS
	help
	  Adds a BLK log line with the flash cache's misses per millisecond of audio, by
	  section (#32): whether 2 ms blocks cost more because of per-call work or because the
	  instruction cache refills each time the code switches between Marbles, MIDI and the
	  engine. Reads the NVMC counter a few times per Plaits block (~0.05 % CPU). Off in
	  release builds.

config SP1_STORAGE
	bool "eMMC storage: a FAT32 volume and its own thread (M6, #43)"
	default SP1_PLAITS
	select FILE_SYSTEM
	select FAT_FILESYSTEM_ELM
	select DISK_ACCESS
	help
	  The eMMC driver (src/sp1_emmc.c), FatFs on top of it, and a low-priority thread
	  that does all the work (src/sp1_store.h): below audio, main and USB, so it costs
	  the audio block nothing. Never formats -- that is SP1_FRESH alone. On in every
	  Plaits image (wakes-sp1, wakes-sp1-fresh); off in the fallback, the recovery image
	  that never touches the eMMC.

config SP1_STORAGE_TEST
	bool "Diagnostics: eMMC report and file test on every entry to ON (#43)"
	depends on SP1_STORAGE
	select INIT_STACKS            # the storage thread's stack headroom, in the report
	help
	  The card's identity, EXT_CSD and partition table (lines starting "EMMC"), then a
	  file test on the volume (lines starting "STORE"): a counter of ON entries that
	  survives power cycles and reflashes, 512 KB written in bursts, read back, compared
	  and deleted, free space and the WAKES directory. Off in release builds.

config SP1_EMMC_VERIFY
	bool "Diagnostics: read every eMMC write back and log any mismatch (#43)"
	depends on SP1_STORAGE
	help
	  Every written block is read straight back; a block that reads back wrong is logged
	  ("EMMC VERIFY FAIL": where in its burst, the card's token and busy, whether a slow
	  re-read agrees) and rewritten on its own. Halves write speed. Off in release builds.
	  (Built for the 2026-10-07 data hunt: every write verified; the fault was in burst
	  READS, src/sp1_emmc.c.)

config SP1_FRESH
	bool "wakes-sp1-fresh: FORMAT the eMMC on the first entry to ON (#43)"
	depends on SP1_STORAGE
	select FILE_SYSTEM_MKFS
	select FS_FATFS_EXTRA_NATIVE_API    # f_setlabel: the volume is labelled "SP-1"
	help
	  ⚠️ Erases the whole eMMC: one FAT32 partition from 4 MB, the build's ID written to
	  WAKES/FRESH.ID, never again while that file matches (src/sp1_store.h). A normal
	  build contains no formatter at all, and tools/ci/check_image.py fails one that does.

config SP1_DRIVE
	bool "Drive mode: the eMMC as a USB drive in STANDBY (#43)"
	depends on SP1_STORAGE
	default y
	select USBD_MSC_CLASS
	help
	  A USB mass-storage interface, always in the descriptor (so going STANDBY <-> ON
	  never re-enumerates and MIDI / audio are never disturbed). In STANDBY with a host
	  attached the card is the host's; turning ON takes it back -- the host then sees "no
	  medium" -- after any command already in progress finishes (src/sp1_store.h). The
	  interface goes LAST, after CDC, MIDI and audio, so their numbers do not move, and
	  bcdDevice changes (SP1_USB_BCD_DEVICE) because the function set did.

config SP1_USB_BCD_DEVICE
	hex "USB bcdDevice"
	default 0x0500 if SP1_DRIVE
	default 0x0403
	help
	  The device release number. 0x0403 is what Zephyr 4.3 put there by default
	  (USB_BCD_DRN) and every release through v0.7.2 shipped with it. One PID for good:
	  when the set of USB functions changes, this changes instead (M5c), so a host that
	  cached the old layout treats the device as new. 0x0500 = + the drive (M6).

# The drive's transfers: 16 blocks per disk call, so a host's large reads and writes become
# CMD18 / CMD25 bursts (sp1_emmc.h). 8 KB of RAM, only in drive builds.
config USBD_MSC_SCSI_BUFFER_SIZE
	default 8192 if SP1_DRIVE

config USBD_MSC_STACK_SIZE
	default 2048 if SP1_DRIVE

# ⚠️ Zephyr formats a volume it cannot mount unless told not to. The card arrives holding
# whatever an earlier firmware left there, so a failed mount must NEVER format: only
# SP1_FRESH formats, and only on purpose. These defaults come before Kconfig.zephyr's, so
# they win; check_image.py also fails an image built with MOUNT_MKFS on.
config FS_FATFS_MOUNT_MKFS
	default n

# Long file names (Adara, M6): presets are "<name>.prst", which 8.3 cannot hold, and samples
# will want readable names. ~0.5 KB of RAM for the name buffer (BSS mode), a few KB of flash;
# nothing in the audio path.
config FS_FATFS_LFN
	default y if SP1_STORAGE

config FS_FATFS_CUSTOM_MOUNT_POINT_COUNT
	default 1 if SP1_STORAGE

config FS_FATFS_CUSTOM_MOUNT_POINTS
	default "EMMC" if SP1_STORAGE

config SP1_LOGBUF_KB
	int "Stored log, in KB of RAM"
	default 16 if SP1_STORAGE
	default 96
	range 4 160
	help
	  Everything printk writes is also kept in RAM, newest last, and played back when a
	  terminal next opens the console -- so a session with the USB port in another host's
	  hands (the OP-XY) is not lost (src/sp1_logbuf.h). Since #52 the session also goes to
	  WAKES/LOGS/ on the drive every 5 s, so this only has to cover the gap between flushes
	  and the boot before the first ON: 16 KB, ~2 minutes of a session (96 KB before, and
	  still in an image without storage -- the fallback -- where RAM is all there is).

config SP1_USB_THREADS_BELOW_AUDIO
	bool "Run Zephyr's USB threads below the audio thread (#32)"
	default y
	depends on UDC_NRF_OUT_FAST
	help
	  Moves the udc_nrfx and usbd threads from K_PRIO_COOP(8), above audio, to main's
	  priority, so enumeration, the console and control requests cannot push an audio
	  block over (src/sp1_usbd.c). Only with the MIDI fast path: MIDI must not wait on
	  these threads, or its timestamps would be up to a block late.

config SP1_MIDI
	bool "USB-MIDI in: notes into Plaits, CCs onto both modules (M5a)"
	default y
	depends on SP1_PLAITS
	help
	  A USB-MIDI 1.0 port (feldd's class, third_party/feldd) next to the console.
	  Notes play Plaits, CCs offset parameters on both modules, all configured by
	  the MIDI script (config/midi.cnfg built in, WAKES/CNFG/midi.cnfg on the drive at
	  every ON). Costs nothing until a host sends something.
	  n: no MIDI function on the USB device at all.

config SP1_USB_AUDIO
	bool "USB audio out: the SP-1's output to the host, USB Audio Class 1.0 (M5c)"
	default y
	depends on SP1_PLAITS && UDC_NRF_ISO_IN_FAST
	help
	  The output the codecs get, after VOL, sent to the host as a 48 kHz 16-bit
	  stereo input (src/sp1_uac.c). Output only: nothing is received from the host.
	  Packets go out from the USB interrupt through the ISO IN fast path
	  (zephyr-patches/udc_nrf-fast-paths.patch), which is required. Costs nothing
	  until a host opens the stream.

config SP1_PLAITS
	bool "Plaits voice as the audio source (M3)"
	default y
	select CPP
	help
	  y: PLAY triggers the Plaits voice (2-op FM), faders are FREQUENCY /
	  TIMBRE / MORPH / HARMONICS, VOL+/- set the output level.
	  n: the M2 440 Hz test tone instead, with its PLAY / VOL controls, and
	  none of the Plaits code is compiled or linked.

	  This is the FALLBACK SWITCH. If the voice faults or overruns on hardware,
	  set CONFIG_SP1_PLAITS=n in prj.conf and rebuild: everything else in the
	  build (headphone mute, LEDs, power) stays exactly as it was.

config SP1_STRING_VOICES
	int "String engine: number of strings (Plaits kNumStrings)"
	range 1 3
	default 2
	depends on SP1_PLAITS
	help
	  How many strings Plaits' String engine rings at once. Upstream is 3.
	  Each TRIG plucks the next string round-robin, so this is how many
	  notes can overlap before the oldest one is re-plucked.

	  2 (default, M3e): every string costs the same, so 2 saves a third of
	  the engine -- 598.6 -> 427.3 instructions/sample in tools/plaits-bench,
	  about 90 % -> 65 % of the audio budget on the SP-1. At 3, String
	  measured 90 % average and 98.5 % peak: it played, with no headroom.

	  Applied at build time to a generated copy of string_engine.h; the
	  vendored file is not modified (see "Plaits overrides" in
	  firmware/CMakeLists.txt). Set it to 3 in prj.conf to A/B the original.

config SP1_PARTICLES
	int "Particle engine: number of particles (Plaits kNumParticles)"
	range 1 6
	default 2
	depends on SP1_PLAITS
	help
	  How many resonant "particles" Plaits' Particle engine runs. Upstream
	  is 6. Plaits divides the density by this count, so the rate of events
	  is the same; fewer means fewer pings ringing at different pitches at
	  once.

	  2 (default, M3h): at 3 (M3f) the SP-1 peaked at 83-100 %, all of it
	  below MORPH centre where the diffuser runs (Adara). Each particle is
	  ~43 instructions/sample. At 6 (upstream) it measured 86 % average /
	  97 % peak. The diffuser is skipped above MORPH centre in any case.

config SP1_MODAL_MODES
	int "Modal engine: number of resonator modes (Plaits kMaxNumModes)"
	range 4 24
	default 12
	depends on SP1_PLAITS
	help
	  Partials of Plaits' modal resonator. Upstream is 24. Must be a
	  multiple of 4 (the resonator renders modes in batches of 4; the build
	  checks). Fewer modes drop the highest partials: the body of a bell
	  stays, its shimmer goes.

	  12 (default, M3g): 8 measured 49 % average / 54 % peak on the SP-1
	  and sounded band-limited (Adara); each batch of 4 modes costs ~100
	  instructions/sample, ~16 %, so 12 is expected near 65 % / 70 %.
	  8 is the fallback. 16 would be ~80 % average -- over the target.

endmenu

source "Kconfig.zephyr"
```

## prj.conf
```kconfig
# wakes-sp1 M0 — the safety floor.
#
# Deliberately minimal. No USB, no console, no audio, no ADC. Every option
# here either keeps the device recoverable or is required to boot at all.
# Things are ADDED in later milestones, never removed to fix a build.

# ---- Recoverability ----
# The watchdog is the final backstop for a hang on a device with no reset pin.
CONFIG_WATCHDOG=y
# k_sys_fatal_error_handler() in main.c turns any fault into a cold reboot.
CONFIG_REBOOT=y

# ---- Fault containment ----
# HW_STACK_PROTECTION reprograms the MPU stack guard on every context switch.
# sp1-tape-looper measured that at ~1 % at the corner and turned it off in
# favour of the cheaper STACK_SENTINEL canary (which Kconfig excludes while
# MPU_STACK_GUARD is on). M0 has CPU to spare and no audio deadline yet, so
# keep the stronger guard here and revisit at M2 when the deadline is real.
CONFIG_HW_STACK_PROTECTION=y

# ---- USB CDC ACM console (M1c) ----
# Exists to make two things possible that are miserable blind: calibrating the
# battery divider, and building the button-ladder threshold tables in M1d.
#
# device_next rather than the legacy CONFIG_USB_DEVICE_STACK: legacy is smaller but
# deprecated, mass storage later would need device_next anyway, and this is the path
# sp1-tape-looper proved on this board and this Zephyr version.
CONFIG_CONSOLE=y
CONFIG_PRINTK=y
CONFIG_SERIAL=y
CONFIG_UART_CONSOLE=y
CONFIG_UART_LINE_CTRL=y
CONFIG_UART_INTERRUPT_DRIVEN=y

CONFIG_USB_DEVICE_STACK_NEXT=y
CONFIG_USBD_CDC_ACM_CLASS=y
# The app owns the single USBD context; do not let the CDC SYS_INIT build a second
# private one that would fight for the controller.
CONFIG_CDC_ACM_SERIAL_INITIALIZE_AT_BOOT=n
CONFIG_HWINFO=y
# The device's identity (VID/PID, names, bMaxPower) is CONFIG_SP1_USB_* in firmware/Kconfig
# since M5a, set by src/sp1_usbd.c rather than Zephyr's sample helper.

# ---- USB-MIDI (M5a) ----
# feldd's MIDI 1.0 class (third_party/feldd) queues its transmit side in a ring buffer.
CONFIG_RING_BUFFER=y
# #32: MIDI is received in the USB interrupt (zephyr-patches/udc_nrf-fast-paths.patch):
# ~110 us of thread hand-offs per message down to a few us, and stamped in the interrupt.
# That frees Zephyr's USB threads to run below audio (CONFIG_SP1_USB_THREADS_BELOW_AUDIO,
# on by default with it).
CONFIG_UDC_NRF_OUT_FAST=y
# M5c: USB audio out sends every packet from the USB interrupt (Ryan Gilmore's ISO IN fast
# path, same patch). CONFIG_SP1_USB_AUDIO (default y) needs it.
CONFIG_UDC_NRF_ISO_IN_FAST=y

CONFIG_LOG=n
CONFIG_ASSERT=n

# The USB stack's init and printf need more main stack than the bare power build.
# 3 KB from M3 (was 2 KB): main now uses the FPU (fader smoothing), so every exception
# taken on its stack carries the extended FP frame, and it calls printk with more args.
CONFIG_MAIN_STACK_SIZE=3072

# ---- Clocking ----
# Matches what the bootloader leaves behind. Do not change without reading
# docs/SAFETY.md -- re-initialising bootloader-owned clocks is on the "do not"
# list for this board.
CONFIG_CLOCK_CONTROL=y
CONFIG_CLOCK_CONTROL_NRF_K32SRC_SYNTH=y


# ---- LED rows on hardware PWM (M1a) ----
# Hardware PWM costs no CPU (EasyDMA), unlike the software PWM sp1-tape-looper
# uses -- which needed a zero-latency IRQ to stop flicker and would compete with
# the audio deadline from M2 on. Do not replace this with a software PWM.
CONFIG_PWM=y
CONFIG_PWM_NRFX=y

# ---- Battery voltage (M1b) ----
# SAADC on AIN4. Only the battery channel for now; the faders join in M1c.
CONFIG_ADC=y

# ---- Output naming ----
# Renames build/zephyr/zephyr.{elf,bin,hex,map,...} to wakes-sp1.{elf,bin,hex,map,...}.
# The build/zephyr/ subdirectory itself is unaffected -- that name comes from the
# Zephyr CMake target, not this option.
CONFIG_KERNEL_BIN_NAME="wakes-sp1"

# ---- Audio output (M2) ----
# I2C to the two codecs (CS42L42 headphone at 0x48, TAS2505 speaker amp at 0x18),
# and the I2S stream as a CLOCK SLAVE on both clocks -- see sp1_audio.h for the
# topology. Same three options sp1-tape-looper proved on this board.
CONFIG_I2C=y
CONFIG_I2S=y
CONFIG_I2S_NRFX=y
# ---- latency (M5b, Adara: "over 30 ms is a no-go"; #32: 10 ms) ----
# Sound leaves Wakes (queued blocks + 3) x the block length after what caused it: one block
# to place a MIDI message on time, the queued blocks, the DMA's next one and the one
# playing (sp1_audio.c). 5 ms x 4 queued was 35 ms, 5 ms x 2 was 25 ms (v0.5.0), 2 ms x 2 was
# 10 ms, and 2 ms x 1 is 8 ms (#32), affordable since Plaits renders 24-sample blocks. The block
# length is CONFIG_SP1_AUDIO_BLOCK_FRAMES (firmware/Kconfig). What it costs: a block that runs
# long has (queued + 1) x 2 = 4 ms -- 200 % of its budget -- before the output runs dry. The
# heaviest session measured (Chords, Marbles, OUTxAUX, drive, a CC stream; 2026-10-04) peaked at
# 96.8 %, and USB enumeration no longer runs above audio.
CONFIG_I2S_NRFX_TX_BLOCK_COUNT=1

# ---- CPU per thread, for the log (M5b diagnostics; src/sp1_threads.h) ----
# The audio sections cannot see what preempts them -- the USB stack runs above audio -- so
# every thread's share is counted at each context switch, on the DWT cycle counter (the
# kernel's own tick would be 30 us coarse). A few cycles per switch.
CONFIG_THREAD_RUNTIME_STATS=y
CONFIG_THREAD_RUNTIME_STATS_USE_TIMING_FUNCTIONS=y
CONFIG_TIMING_FUNCTIONS=y
CONFIG_THREAD_MONITOR=y
CONFIG_THREAD_NAME=y

# Floating-point unit. Nothing in M2 uses float -- the tone and the meter are
# integer-only on purpose -- but Plaits is float throughout from M3. Turning the FPU
# on HERE means M3 changes one thing (the synth), not two (the synth and the
# FP context-switch behaviour).
CONFIG_FPU=y
# Preserve FP registers across context switches. CONFIG_FPU alone is Zephyr's
# UNSHARED mode: FP state is not saved when threads switch. Plaits (float) will run in
# the audio thread, and any float in main, USB or an ISR would silently corrupt it --
# and with the hard-float ABI the compiler may use VFP registers for plain data moves
# too. Set now, with the FPU, so M3 does not inherit a latent corruption bug.
CONFIG_FPU_SHARING=y

# ---- M3: the Plaits voice ----
# The fallback switch: n = the M2 test tone, and no Plaits code is built at all.
CONFIG_SP1_PLAITS=y
# Plaits is C++ (no exceptions, no RTTI -- the Zephyr defaults) and needs <algorithm>
# and <cmath>, which the minimal C++ library does not provide.
CONFIG_CPP=y
CONFIG_STD_CPP14=y
CONFIG_GLIBCXX_LIBCPP=y
# ⚠️ The audio thread runs at K_PRIO_PREEMPT(0) and MUST outrank main, so main moves
# to 1. From M3 the audio work is ~half the CPU; at equal priority the ADC scan and
# every printk would compete with the audio deadline. See sp1_audio.h.
CONFIG_MAIN_THREAD_PRIORITY=1
```

## src/sp1_audio.h
```c
/*
 * wakes-sp1 — audio output: codecs, 48 kHz I2S, output level, headphone detect, and
 * the block loop that runs the synth voice (M3) or the fallback test tone.
 *
 * ---- clock topology (TE's own, and the only one proven on this board) ----
 * The 3.072 MHz oscillator (P0.13) drives the I2S bit clock. The CS42L42 headphone
 * codec is the FRAME master: it divides that clock by 64 to make a frame clock of
 * exactly 48 000 Hz. The nRF52840 I2S peripheral and the TAS2505 speaker amp are both
 * CLOCK SLAVES. sp1-tape-looper found the hard way that having the nRF master the
 * clocks instead (at ~47 619 Hz) crackled on the speaker and gave only noise on the
 * headphones.
 *
 * ---- bring-up order, copied exactly from the proven path. DO NOT "TIDY" IT ----
 *   1. release both codec resets, 20 ms
 *   2. oscillator ON, 5 ms          -> the bit clock now exists
 *   3. start the I2S stream         -> nRF waits as a slave; there is no frame yet
 *   4. configure the TAS2505        -> its PLL locks to the BIT clock, already live
 *   5. configure the CS42L42        -> it starts mastering the FRAME clock, and the
 *                                      stream the nRF queued in step 3 begins to flow
 * Step 3 before step 5 looks backwards and is not: the amp only needs the bit clock,
 * the nRF just waits for frames, and this is the order that works on hardware.
 *
 * ---- priority: audio OUTRANKS main (M3) ----
 * Audio runs at K_PRIO_PREEMPT(0); CONFIG_MAIN_THREAD_PRIORITY=1 in prj.conf puts the
 * main loop below it. In M2 both were 0 and time-sliced (TIMESLICE_PRIORITY=0, 20 ms
 * slices), which was fine for a sine at ~7 % of the CPU and not for Plaits at ~50 %:
 * a 430 us ADC scan or a printk stalled by the host could then sit in front of an
 * audio block. Now the audio thread takes the CPU whenever a block is due, and main
 * runs in the gaps.
 *
 * ---- and therefore the audio thread must NEVER spin ----
 * The main loop is what feeds the watchdog and runs power-off. A thread that spins
 * ABOVE it starves both.
 *
 * What an OVERRUN does (voice slower than real time) -- checked against the pinned
 * i2s_nrfx.c, and not what an earlier version of this comment claimed: the driver
 * misses a buffer ("next buffers not supplied"), the stream goes to I2S_STATE_ERROR,
 * i2s_write() then fails at once, and the write-failure path SLEEPS 2 ms per failure
 * and re-primes after 8. So main still gets time: the device stays up with broken,
 * stuttering audio and a slower control loop, and power-off keeps working. It does
 * NOT starve into a watchdog reset -- so when debugging an overrun in M4, look for
 * `fail`/`rst` climbing on the AUD line, not for a reboot. CONFIG_SP1_PLAITS=n builds
 * the known-good tone firmware.
 *
 * tape-looper's write-failure path does `free; continue` with no sleep, which spins if
 * writes fail instantly. Every path through this thread blocks or sleeps instead. See
 * sp1_audio.c.
 *
 * ---- start/stop are bounded, always ----
 * sp1_audio_stop() is on the POWER-OFF path (sp1_quiesce_peripherals calls it). It
 * never waits more than 50 ms for the thread, whatever state the thread is in, and
 * power-off proceeds regardless -- rule 5a: power-off does not depend on anything
 * else succeeding.
 */
#ifndef SP1_AUDIO_H
#define SP1_AUDIO_H

#include <stdint.h>
#include <stdbool.h>

/* Create the audio thread (it parks immediately) and enable the DWT cycle counter.
 * Once, at boot, after the power-on gate. Safe to call stop() before this. */
void sp1_audio_init(void);

/* Bring the audio path up: resets released, oscillator on, stream started, both
 * codecs configured. Call on every entry to ON -- the way into STANDBY powers all of
 * it down. Bounded: never blocks longer than ~1 s, feeds the watchdog while it waits.
 * Returns 0 on success, negative if the stream could not be started. */
int sp1_audio_start(void);

/* Stop the stream. On the power-off path: waits at most 50 ms for the thread, then
 * returns REGARDLESS. Safe to call when audio was never started. */
void sp1_audio_stop(void);

/* Halt the I2S peripheral at register level and disconnect its pins. ONLY on the way
 * to SYSTEM_OFF -- never STANDBY, because the driver applies its pinctrl once at boot
 * and would not restore the pins. See sp1_audio.c. */
void sp1_audio_halt_for_system_off(void);

/* Peak |sample| (0..32767) of everything produced since the last call, then reset.
 * For the meter. Lock-free: one atomic swap. */
uint32_t sp1_audio_take_peak(void);

/* ---- OUTPUT LEVEL (VOL+ / VOL-) ----
 * 3 dB steps, slewed in the audio path so a change never clicks. Step 0 = 0 dBFS; the
 * last step is mute. Every TWO steps is one meter band (6.02 dB). Applies to the synth
 * and to the fallback tone alike, and to speaker and headphones alike -- the speaker's
 * extra speaker trim is separate and fixed (SP1_SPK_ATTEN_HALF_DB in sp1_audio.c:
 * -9 dB in M3, -6 dB since M4a). */
#define SP1_LEVEL_STEPS     12      /* 0 .. 10 = 0 .. -30 dB, 11 = mute */
#if defined(CONFIG_SP1_PLAITS)
#define SP1_LEVEL_DEFAULT    2      /* -6 dBFS                                */
#else
#define SP1_LEVEL_DEFAULT    4      /* -12 dBFS for the test tone, as in M2   */
#endif

void sp1_audio_level_step(int delta);  /* +1 = quieter by 3 dB, -1 = louder */
int  sp1_audio_level_get(void);

#if defined(CONFIG_SP1_USB_AUDIO)
/* #52: the audio settings from the drive (audio.cnfg). Main, at ON entry. sp1_audio_config()
 * is the live copy (the built-in one until then). */
struct sp1_audio_cfg;
void sp1_audio_set_config(const struct sp1_audio_cfg *c);
const struct sp1_audio_cfg *sp1_audio_config(void);
#endif
int  sp1_audio_level_db_x10(void);     /* tenths of dBFS, -9990 = mute      */

/* ---- the fallback test tone (CONFIG_SP1_PLAITS=n only): 440 Hz, off at start ---- */
void sp1_audio_tone_set(bool on);
bool sp1_audio_tone_on(void);

/* ---- headphone detect -> speaker mute (M3), and the USB audio mute (M5c) ----
 * Call from the main loop every tick while ON, after sp1_audio_start(). Polls the
 * CS42L42 jack sense every 40 ms, debounced, and powers the speaker down while a plug
 * is in -- or while a host is taking USB audio out (stream open AND packets flowing).
 * Headphones always play. Returns -1
 * (nothing new), 0 (unplugged), 1 (plugged), 2 (detect failed repeatedly: disabled for
 * this session, speaker ON -- the USB mute with it), 3 (a host started taking USB audio:
 * speaker off) or 4 (no host is taking it any more: speaker back on, unless headphones
 * are in). */
int sp1_audio_jack_poll(uint32_t elapsed_ms);
int sp1_audio_jack_state(void);        /* 1 in, 0 out, -1 unknown */
bool sp1_audio_speaker_on(void);       /* what the speaker amp is actually set to */

/* Block cost since the last call: worst and mean cycles per block. Read-and-clear. */
void sp1_audio_take_cycles(uint32_t *max, uint32_t *avg);

/* Where the blocks since the last call went (issue #22): mean and worst cycles per block
 * for each section, and how often the whole block ran over. Read-and-clear, like
 * sp1_audio_take_cycles(), and meant to be read in the same place.
 *
 *   ENG / MRB / POST   sp1_synth.h's sections
 *   RTE                the rest of sp1_synth_render(): Marbles -> Plaits routing, TRIG
 *   OUT                the rest of the block: gain ramp, stereo copy, meter peak
 *
 * `over` counts blocks that cost more than the budget; `over_run` is the longest run of
 * them in a row. A long run is what starves the main loop -- one late block is absorbed
 * by the I2S queue, a second of them is not. */
enum {
	SP1_SEC_ENG, SP1_SEC_MRB, SP1_SEC_RTE, SP1_SEC_POST, SP1_SEC_OUT, SP1_SEC_N
};
struct sp1_audio_sections {
	uint32_t avg[SP1_SEC_N];
	uint32_t max[SP1_SEC_N];
	uint32_t over;
	uint32_t over_run;
	/* #32: the once-per-audio-block part of rte (sp1_synth.h, `pre`), avg/max cycles. */
	uint32_t pre_avg, pre_max;
	uint32_t pre_midi_avg, pre_route_avg;   /* #32 B1: parts of pre, avg cycles */
	/* #32, CONFIG_SP1_PROFILE_ICACHE (zeros otherwise): flash-cache misses SUMMED over the
	 * window per section (index SP1_SEC_*; rte excludes pre, which is miss_pre), the blocks
	 * they came from, and the cache's own totals for every thread (NVMC IHIT / IMISS). */
	uint32_t miss[SP1_SEC_N];
	uint32_t miss_pre;
	uint32_t blocks;
	uint32_t icache_hit, icache_miss;
	/* #32: the slowest single engine call in the window (cycles), its Plaits engine, and
	 * whether it was the first call after an engine change. */
	uint32_t eng_worst;
	uint8_t eng_worst_engine;
	bool eng_worst_first;
};
void sp1_audio_take_sections(struct sp1_audio_sections *out);

/* ---- diagnostics ---- */
struct sp1_audio_stats {
	uint32_t blocks;         /* blocks handed to I2S                         */
	uint32_t write_fails;    /* i2s_write errors                             */
	uint32_t restarts;       /* stream drop + re-prime after repeated fails  */
	uint32_t cyc_max;        /* worst cycles spent generating one block      */
	uint32_t cyc_budget;     /* cycles available per block                   */
	int      cfg_rc;         /* last i2s_configure() result                  */
	bool     running;
	bool     tas_ok;         /* every TAS2505 write ACKed                    */
	bool     hp_ok;          /* CS42L42 identified and configured            */
};
void sp1_audio_stats(struct sp1_audio_stats *out);

#endif /* SP1_AUDIO_H */
```

## src/sp1_board.h
```c
/*
 * wakes-sp1 — SP-1 hardware pin map.
 *
 * Pin numbers from timknapen/SP-1-dev src/stemplayer_pins.h (MIT).
 * The LED port/pin pairs are the map chattock/sp1-tape-looper (MIT) marks as
 * hardware-verified; note that TimK's header lists the playback LEDs in a
 * different order. Trust the verified map, not the header ordering.
 */
#ifndef SP1_BOARD_H
#define SP1_BOARD_H

#include <zephyr/kernel.h>
#include <soc.h>

/* ---- Function button "••" : direct GPIO, pull-up, active low ---- */
#define SP1_FNC_PORT        NRF_P0
#define SP1_FNC_PIN         27u

/* ---- Button-ladder common rail (powers both resistor ladders) ---- */
#define SP1_BTN_COM_PORT    NRF_P1
#define SP1_BTN_COM_PIN     10u

/* ---- BQ24232 battery charger ----
 * The charger IC runs the CC/CV profile, termination, safety timer and thermal
 * regulation autonomously. Firmware CANNOT set the charge current: ISET is a
 * current-MONITORING output (an ADC input here), not a control. The part is
 * hardware-configured for 500 mA max USB draw. Our whole job is: hold nCE low
 * to enable charging, and read the two status pins. */
#define SP1_BQ_PORT         NRF_P0
#define SP1_BQ_NCE_PIN      21u   /* out, ACTIVE LOW: drive low = charging on   */
#define SP1_BQ_NCHG_PIN     22u   /* in, open-drain, LOW = charging now         */
#define SP1_BQ_NPGOOD_PIN   24u   /* in, open-drain, LOW = USB power present    */
/* ISET P1.00 and BATT_LEVEL P0.28/AIN4 are ADC inputs; used from M1 on. */

/* ---- Reset / enable lines for the chips around the nRF ---- */
#define SP1_TAS_RST_PORT    NRF_P0   /* TAS2505 speaker amp, active low  */
#define SP1_TAS_RST_PIN     9u
#define SP1_CS42_RST_PORT   NRF_P0   /* CS42L42 headphone codec, act low */
#define SP1_CS42_RST_PIN    15u
#define SP1_OSC_EN_PORT     NRF_P0   /* 3.072 MHz audio osc, active high  */
#define SP1_OSC_EN_PIN      13u
#define SP1_EMMC_VCCQ_PORT  NRF_P0   /* eMMC I/O rail, active high        */
#define SP1_EMMC_VCCQ_PIN   14u
/* eMMC bus (M6, #43): 1-bit MMC, bit-banged -- the nRF52840 has no SD/MMC peripheral.
 * CLK, DAT0 and CMD must stay on port 0: sp1_emmc.c clocks data through NRF_P0's
 * registers directly. Used only by sp1_emmc.c. */
#define SP1_EMMC_CLK_PIN    6u       /* P0.06                              */
#define SP1_EMMC_DAT0_PIN   7u       /* P0.07                              */
#define SP1_EMMC_CMD_PIN    8u       /* P0.08                              */
#define SP1_EMMC_RST_PORT   NRF_P1   /* RST_n, active low                  */
#define SP1_EMMC_RST_PIN    8u       /* P1.08                              */
#define SP1_BT_RST_PORT     NRF_P0   /* CYBT module, active low           */
#define SP1_BT_RST_PIN      10u

/* ---- LEDs: owned by PWM, NOT by GPIO ----
 * Both rows are driven by hardware PWM (PWM2 = track row, PWM3 = play row) and
 * their pins are claimed by pinctrl. DO NOT write these pins as GPIO -- it
 * fights the PWM peripheral and produces flicker or a stuck LED. Use the
 * sp1_led.h API.
 *
 * Recorded here only because the pinctrl CHANNEL ORDER in
 * boards/teenageengineering/stem_player/stem_player-pinctrl.dtsi must match the
 * LED indices, and changing one without the other scrambles the display:
 *
 *   track row (PWM2), the "model row" above T1-T4:
 *     ch0 = P0.29   ch1 = P0.26   ch2 = P1.15   ch3 = P1.14
 *   play row (PWM3), the side row / VU meter:
 *     ch0 = P1.13   ch1 = P0.00   ch2 = P1.12   ch3 = P0.01
 *
 * This is the order sp1-tape-looper marks as hardware-verified. TimK's
 * stemplayer_pins.h lists the play LEDs differently -- trust this one. */

#endif /* SP1_BOARD_H */
```

## src/sp1_cnfg.h
```c
/*
 * wakes-sp1 — the config files on the drive (#52): WAKES/CNFG/<name>.cnfg.
 *
 * Pure C, no Zephyr, no storage: the storage thread reads a file a chunk at a time and feeds
 * it here; the host suite (tools/host-tests/cnfgtest.c) feeds it broken files.
 *
 * ---- the rules (Adara, #52) ----
 *   - config/<name>.cnfg in the repository is the built-in DEFAULT, compiled into every
 *     image (tools/gen_<name>.py, which fails the build on a bad default). End users never
 *     touch it: they edit the copy on the drive, which every image writes there when it is
 *     missing (Adara: no trip to the repo, no fresh flash, to get a file back).
 *   - Read at EVERY ON, before PRST and before audio. A line overrides its default; a line
 *     left out keeps it; a line that cannot be read keeps it too, and the log names it.
 *   - The same key twice: the FIRST is used, the later one is reported.
 *   - Nothing in a config file touches the power path, the watchdog, the flash layout or
 *     the USB descriptors (docs/SAFETY.md).
 *
 * ---- the format: ini ----
 *   [section]          names ignore case
 *   key = value        keys ignore case; ; or # after whitespace starts a comment
 *   ; comment / # comment
 * A UTF-8 byte order mark is skipped. Lines are at most SP1_CNFG_LINE_MAX bytes.
 */
#ifndef SP1_CNFG_H
#define SP1_CNFG_H

#include <stdbool.h>
#include <stddef.h>
#include <stdint.h>

#define SP1_CNFG_LINE_MAX  160
#define SP1_CNFG_NAME_MAX  24

/* A problem with one line: `what` is the line (or its key), `why` the reason and what Wakes
 * does instead. The firmware prints "CNFG <file> line N: <what> -- <why>". */
typedef void (*sp1_cnfg_problem_fn)(void *ctx, int line, const char *what, const char *why);

/* One `key = value` (section, key lowercased; value trimmed, comment removed). */
typedef void (*sp1_cnfg_entry_fn)(void *ctx, int line, const char *section, const char *key,
				  const char *value);

/* LINE MODE (scales.cnfg, #44): every line that is not a ; / # comment, as it is -- trimmed,
 * an inline comment removed, and BLANK lines included (a Scala description may be empty).
 * `header` is true for a [section] line, with `text` = its name; a [section] that cannot be
 * read is reported and then delivered as header "" so the reader stops the section before. */
typedef void (*sp1_cnfg_line_fn)(void *ctx, int line, const char *section, bool header,
				 const char *text);

struct sp1_cnfg_parser {
	sp1_cnfg_entry_fn   entry;
	sp1_cnfg_line_fn    raw;          /* set: line mode, `entry` unused */
	sp1_cnfg_problem_fn problem;
	void *ctx;
	char  section[SP1_CNFG_NAME_MAX];
	char  buf[SP1_CNFG_LINE_MAX + 1];
	size_t n;
	int   line;
	bool  overlong;
};

void sp1_cnfg_begin(struct sp1_cnfg_parser *p, sp1_cnfg_entry_fn entry,
		    sp1_cnfg_problem_fn problem, void *ctx);
void sp1_cnfg_begin_lines(struct sp1_cnfg_parser *p, sp1_cnfg_line_fn raw,
			  sp1_cnfg_problem_fn problem, void *ctx);
void sp1_cnfg_feed(struct sp1_cnfg_parser *p, const char *text, size_t n);
void sp1_cnfg_end(struct sp1_cnfg_parser *p);

/* ---------------------------------------------------------------- logs.cnfg */

/* What goes into the log file besides the lines that always do. */
#define SP1_LOG_PERFORMANCE  0x01u
#define SP1_LOG_CONTROLS     0x02u
#define SP1_LOG_MIDI         0x04u
#define SP1_LOG_USB          0x08u
#define SP1_LOG_STORAGE      0x10u
#define SP1_LOG_SCALES       0x20u   /* scales.cnfg: what each ON loaded (#44) */
#define SP1_LOG_ALL          0x3Fu

struct sp1_logs_cfg {
	bool    enabled;
	uint8_t cats;           /* SP1_LOG_* bits */
};

/* The built-in defaults, from config/logs.cnfg (sp1_logs_gen.h). */
void sp1_logs_defaults(struct sp1_logs_cfg *c);

/* Read logs.cnfg's text over the defaults already in *c. Returns the number of problems. */
struct sp1_logs_reader {
	struct sp1_cnfg_parser p;
	struct sp1_logs_cfg *cfg;
	sp1_cnfg_problem_fn problem;
	void *ctx;
	uint8_t seen;           /* keys already set (the first wins) */
	char  bad_section[SP1_CNFG_NAME_MAX];
	char  what[SP1_CNFG_LINE_MAX + 4];
	int   problems;
};
void sp1_logs_begin(struct sp1_logs_reader *r, struct sp1_logs_cfg *c,
		    sp1_cnfg_problem_fn problem, void *ctx);
void sp1_logs_feed(struct sp1_logs_reader *r, const char *text, size_t n);
int  sp1_logs_end(struct sp1_logs_reader *r);

/* The categories as words, for the log: "performance controls midi usb storage scales" or
 * "none". buf of at least 48 bytes. */
const char *sp1_logs_describe(uint8_t cats, char *buf, size_t size);

/* Which category a log line belongs to, from its tag -- the first word after the
 * "[+hh:mm:ss.mmm] " stamp (CPU, MIDI, STORE, ...). 0 = always written: startup, power,
 * battery, warnings, and any line without a known tag. */
uint8_t sp1_log_category(const char *line, size_t n);

/* ---------------------------------------------------------------- engines.cnfg */

/* Two engine names are the same engine when their letters and digits match, case ignored
 * (tools/gen_engines.py, name_key): "grain / formant", "grain-formant" and "Grain Formant"
 * are one engine -- so a PRST file saved under an older spelling still loads. `canon` is
 * NUL-terminated; `s` is `n` bytes. */
static inline bool sp1_engine_name_eq(const char *canon, const char *s, size_t n)
{
	size_t i = 0u;
	for (;;) {
		while (*canon != '\0' && !((*canon >= 'a' && *canon <= 'z') ||
					   (*canon >= 'A' && *canon <= 'Z') ||
					   (*canon >= '0' && *canon <= '9'))) {
			canon++;
		}
		while (i < n && !((s[i] >= 'a' && s[i] <= 'z') || (s[i] >= 'A' && s[i] <= 'Z') ||
				  (s[i] >= '0' && s[i] <= '9'))) {
			i++;
		}
		if (*canon == '\0' || i == n) {
			return *canon == '\0' && i == n;
		}
		const char a = (*canon >= 'A' && *canon <= 'Z') ? (char)(*canon - 'A' + 'a') : *canon;
		const char b = (s[i] >= 'A' && s[i] <= 'Z') ? (char)(s[i] - 'A' + 'a') : s[i];
		if (a != b) {
			return false;
		}
		canon++;
		i++;
	}
}

/* The stack: SP1_CNFG_SLOTS Plaits engine indices, SP1_CNFG_EMPTY for an empty slot (the
 * same values as sp1_engines_gen.h's SP1_ENGINE_DEFAULT_STACK; sp1_cnfg.c checks). */
#define SP1_CNFG_SLOTS 24
#define SP1_CNFG_EMPTY 255u

/* An engine of this build by name (sp1_engine_name_eq): its Plaits index, or -1. */
int sp1_engine_index(const char *name, size_t n);

/* The built-in stack (config/engines.cnfg at build time). */
void sp1_engines_defaults(uint8_t out[SP1_CNFG_SLOTS]);

/* Read engines.cnfg. The file is the WHOLE stack (Adara, #52): a slot it does not name is
 * empty. Unlike logs.cnfg, a stack is all or nothing -- half of one would play engines in
 * slots nobody chose -- so ANY problem (a name that is not an engine, an engine twice, a
 * slot outside 1-24, a slot twice, another section, no engine at all) makes the whole file
 * unusable and Wakes uses the built-in stack, every problem named in the log. */
struct sp1_engines_reader {
	struct sp1_cnfg_parser p;
	sp1_cnfg_problem_fn problem;
	void *ctx;
	uint8_t  stack[SP1_CNFG_SLOTS];
	uint32_t seen;          /* slots set, bit per slot             */
	uint32_t used;          /* engines used, bit per Plaits index  */
	char  bad_section[SP1_CNFG_NAME_MAX];
	char  what[SP1_CNFG_LINE_MAX + 4];
	int   problems;
	int   filled;
};
void sp1_engines_begin(struct sp1_engines_reader *r, sp1_cnfg_problem_fn problem, void *ctx);
void sp1_engines_feed(struct sp1_engines_reader *r, const char *text, size_t n);
/* The number of problems. `out` is the file's stack when there were none, otherwise the
 * built-in stack. `*filled` = engines in `out`. */
int  sp1_engines_end(struct sp1_engines_reader *r, uint8_t out[SP1_CNFG_SLOTS], int *filled);

/* ---------------------------------------------------------------- audio.cnfg */

/* How sound leaves the device: USB audio out's level and the speaker while a host takes it.
 * The built-in values are config/audio.cnfg's (SP1_AUDIO_CFG_DEFAULTS, sp1_audio_gen.h, in
 * this field order); sp1_audio.c holds the live copy (sp1_audio_set_config). */
struct sp1_audio_cfg {
	uint8_t parked;          /* [usb] level: 1 parked, 0 vol                         */
	int8_t  parked_db;       /* [usb] parked_level, 0 .. -30 in 3 dB steps          */
	uint8_t parked_step;     /* ...as VOL's step, -parked_db / 3                    */
	uint8_t speaker;         /* [usb] speaker: 1 on while a host takes USB audio out */
};
void sp1_audio_cfg_defaults(struct sp1_audio_cfg *c);

/* Line by line over the built-in values, like logs.cnfg. */
struct sp1_audio_reader {
	struct sp1_cnfg_parser p;
	struct sp1_audio_cfg *cfg;
	sp1_cnfg_problem_fn problem;
	void *ctx;
	uint8_t seen;
	char  bad_section[SP1_CNFG_NAME_MAX];
	char  what[SP1_CNFG_LINE_MAX + 4];
	int   problems;
};
void sp1_audio_reader_begin(struct sp1_audio_reader *r, struct sp1_audio_cfg *c,
			    sp1_cnfg_problem_fn problem, void *ctx);
void sp1_audio_reader_feed(struct sp1_audio_reader *r, const char *text, size_t n);
int  sp1_audio_reader_end(struct sp1_audio_reader *r);

/* ---------------------------------------------------------------- midi.cnfg */

#include "sp1_midi_gen.h"        /* SP1_MIDI_DESTS and the destination enum */

/* The MIDI script. The built-in values are config/midi.cnfg's (SP1_MIDI_CFG_DEFAULTS,
 * sp1_midi_gen.h, in this field order); sp1_midi.cc holds the live copy
 * (sp1_midi_set_config), which every thread reads and only main writes, at ON entry with the
 * audio thread stopped. */
struct sp1_midi_cfg {
	int8_t   channel;        /* 0-15, or SP1_MIDI_OMNI                              */
	uint8_t  priority;       /* stmlib NoteStackFlags: 0 last, 1 low, 2 high        */
	uint8_t  legato;         /* Yarns legato_mode: 0 off, 1 auto, 2 on              */
	uint8_t  portamento;     /* Yarns: 0 none, 1-50 time, 51-101 rate               */
	uint8_t  bend_range;     /* semitones, until RPN 0 says otherwise               */
	int8_t   sustain_cc;     /* -1 = no sustain pedal                               */
	uint8_t  smooth_ms;      /* 0-200                                               */
	uint8_t  pickup;         /* SP1_MIDI_PICKUP_SUM / _SHARED / _TAKEOVER           */
	uint8_t  clock;          /* 1 = Marbles follows MIDI clock + transport          */
	int16_t  clock_lead_ms;  /* 0-200; -1 auto, -2 notes                            */
	int8_t   vel_dest;       /* [bind] velocity: a destination, or -1               */
	int8_t   at_dest;        /* [bind] aftertouch                                   */
	float    vel_depth;      /* -1 .. 1                                             */
	float    at_depth;
	int8_t   dest_cc[SP1_MIDI_DESTS];   /* destination -> its CC (coarse half), or -1 */
	int8_t   cc_dest[128];              /* CC -> destination, or -1                 */
};
void sp1_midi_cfg_defaults(struct sp1_midi_cfg *c);

/* Line by line over the built-in values, like logs.cnfg -- plus the CC rule (Adara, #52):
 *   - a CC you give a parameter (or the sustain pedal) is TAKEN from whichever parameter had
 *     it by default, which gets none (a note in the log, not a problem);
 *   - two of your lines on the same CC: the FIRST keeps it, the later gets none (a problem);
 *   - CC 33-63 are the fine halves of 1-31 and cannot be given; reserved CCs neither.
 * `velocity = none` / `aftertouch = none` remove a binding. */
#define SP1_MIDI_WHO_SUSTAIN SP1_MIDI_DESTS
struct sp1_midi_reader {
	struct sp1_cnfg_parser p;
	struct sp1_midi_cfg *cfg;
	sp1_cnfg_problem_fn problem;
	void *ctx;
	uint16_t seen_midi;                      /* [midi] keys set (the first wins)       */
	uint32_t seen_dest;                      /* destinations set                       */
	uint8_t  seen_bind;
	int8_t   user_cc[SP1_MIDI_DESTS + 1];    /* -2 not given, -1 none, else the CC;    */
	int16_t  user_line[SP1_MIDI_DESTS + 1];  /*   index SP1_MIDI_WHO_SUSTAIN = sustain */
	uint8_t  order[SP1_MIDI_DESTS + 1];      /* the CC lines in file order             */
	uint8_t  n_order;
	char  bad_section[SP1_CNFG_NAME_MAX];
	char  what[SP1_CNFG_LINE_MAX + 4];
	char  why[160];
	int   problems;
	int   notes;                             /* defaults that gave up their CC         */
};
void sp1_midi_reader_begin(struct sp1_midi_reader *r, struct sp1_midi_cfg *c,
			   sp1_cnfg_problem_fn problem, void *ctx);
void sp1_midi_reader_feed(struct sp1_midi_reader *r, const char *text, size_t n);
/* Problems; `*notes` = defaults that gave up their CC to one of your lines. */
int  sp1_midi_reader_end(struct sp1_midi_reader *r, int *notes);

/* ---------------------------------------------------------------- scales.cnfg */

#include "sp1_scales.h"

/* scales.cnfg (#44): a [1]-[7] section per slot, each holding one Scala (.scl) scale
 * (config/scales.cnfg explains the format to users; tools/gen_scales.py reads it the same way
 * at build time):
 *
 *   [3]
 *   plaits = 32            Wakes: Plaits plays the degrees of weight >= 32 (default 0, all)
 *   tune_by_ear = off      Wakes: Plaits' root stays C (default on: Tune By Ear, #30)
 *   ! comment              Scala's comment lines
 *   name                   the description: the first other line (may be blank after a !)
 *   12                     how many pitches follow, the period included (1-64)
 *   100.0  16              cents (has a "."), or a ratio (3/2, 2); then a WEIGHT 0-255
 *   ...                    (Wakes: missing = 255; any other text after the pitch ignored)
 *   2/1                    the last pitch is the period
 *
 * The root is implicit (0 V, weight 255). Pitches may come in any order; each must lie
 * strictly between the root and the period, and two may not be equal.
 *
 * ALL OR NOTHING, like engines.cnfg: any problem in any scale -> the built-in bank, every
 * problem named. The one exception (Adara): a slot above [7] is DROPPED with a note that the
 * file is overloaded, and the rest still loads.
 *
 * [scales_wiki] ends the scales (Adara, #44): NOTHING below it is read -- the scale library
 * lives there uncommented, between copy markers, ready to paste above it. A [n] found below
 * it is a note ("move it above"), never a problem; long lines there are not reported. */
struct sp1_scales_reader {
	struct sp1_cnfg_parser p;
	sp1_cnfg_problem_fn problem;
	void *ctx;
	struct sp1_scale_bank *bank;
	float    pitch[SP1_SCALE_DEGREES];   /* this scale's pitches as read, in volts      */
	uint8_t  pw[SP1_SCALE_DEGREES];      /* ...their weights                            */
	int      pl[SP1_SCALE_DEGREES];      /* ...their lines                              */
	int      slot;           /* the section's slot 0-6; -1 none yet, -2 set aside       */
	int      head_line;      /* the section's [n] line                                  */
	int      at;             /* problems before this section: its own start from here  */
	uint8_t  state;
	bool     bang;           /* a ! line came before the description                    */
	bool     plaits_set;
	bool     by_ear_set;
	uint8_t  count;          /* pitches the count line promised                         */
	uint8_t  got;
	uint8_t  seen;           /* slots with a section, bit per slot                      */
	bool     loose;          /* a line outside any slot has been reported               */
	bool     wiki;           /* below [scales_wiki]: nothing more is read (#44)         */
	int      wiki_notes;     /* slots found below it, reported as notes                 */
	char     what[SP1_CNFG_LINE_MAX + 8];
	char     why[112];
	int      problems;
	int      dropped;        /* slots above [7]                                         */
	int      filled;
};
void sp1_scales_begin(struct sp1_scales_reader *r, struct sp1_scale_bank *out,
		      sp1_cnfg_problem_fn problem, void *ctx);
void sp1_scales_feed(struct sp1_scales_reader *r, const char *text, size_t n);
/* The number of problems. *out is the file's bank when there were none, otherwise the built-in
 * one. `*filled` = scales in *out, `*dropped` = slots above [7] that were left out. */
int  sp1_scales_end(struct sp1_scales_reader *r, int *filled, int *dropped);

/* A pitch as Scala writes it -- "100.0" (cents) or "3/2" / "2" (a ratio) -- in volts at
 * 1 V/oct. False if it is not one (a negative or zero ratio included). */
bool sp1_scl_pitch(const char *s, size_t n, float *volts);

#endif /* SP1_CNFG_H */
```
