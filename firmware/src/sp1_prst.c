/* wakes-sp1 — PRST presets: the slot format and its field check. See sp1_prst.h. */
#include "sp1_prst.h"

#include <math.h>
#include <stdint.h>
#include <stdio.h>
#include <string.h>

/* ---- the field table, generated by tools/gen_prst.py ---- */
struct sp1_prst_choice {
	const char *tok;
	int val;
};
struct sp1_prst_field {
	const char *section;
	const char *key;
	uint8_t kind;                         /* SP1_PRST_K_*                       */
	uint8_t check;                        /* SP1_PRST_C_*                       */
	const struct sp1_prst_choice *ch;     /* the tokens, for SP1_PRST_K_CHOICE  */
	uint8_t n_ch;
	uint16_t off;                         /* into struct sp1_prst               */
};
#include "sp1_prst_gen.h"

/* Every choice list covers its whole enum: a value the firmware can hold but the file cannot
 * name would be dropped at save and come back as the default. */
#define N_OF(a) (sizeof(a) / sizeof((a)[0]))
_Static_assert(N_OF(sp1_prst_ch_dest) == SP1_DEST_COUNT, "a destination has no token");
_Static_assert(N_OF(sp1_prst_ch_scale) == SP1_MARBLES_SCALES, "a scale has no token");
_Static_assert(N_OF(sp1_prst_ch_scale_off) == SP1_MARBLES_SCALES + 1, "quantizer tokens");
_Static_assert(N_OF(sp1_prst_ch_output) == SP1_OUT_COUNT, "an output mode has no token");
_Static_assert(N_OF(sp1_prst_ch_drive) == SP1_DRIVE_STEPS, "a drive step has no token");
_Static_assert(N_OF(sp1_prst_ch_range) == SP1_MRB_RANGE_COUNT, "a [J] range has no token");
_Static_assert(N_OF(sp1_prst_ch_t_model) == 6, "a t model has no token");
_Static_assert(N_OF(sp1_prst_ch_burst) == 8, "burst divisions 1/1 .. 1/128");

/* ---- text helpers ---- */
struct span {
	const char *p;
	int n;
};

static int lower(int c)
{
	return (c >= 'A' && c <= 'Z') ? c - 'A' + 'a' : c;
}

static bool is_space(char c)
{
	return c == ' ' || c == '\t' || c == '\r';
}

static struct span trim(const char *p, int n)
{
	while (n > 0 && is_space(p[0])) {
		p++;
		n--;
	}
	while (n > 0 && is_space(p[n - 1])) {
		n--;
	}
	return (struct span){ p, n };
}

/* Case-insensitive: the span equals the NUL-terminated `s`. */
static bool eq(struct span a, const char *s)
{
	int k = 0;
	for (; k < a.n; k++) {
		if (s[k] == '\0' || lower((unsigned char)a.p[k]) != lower((unsigned char)s[k])) {
			return false;
		}
	}
	return s[k] == '\0';
}

static float *pos_at(struct sp1_prst *p, const struct sp1_prst_field *f)
{
	return (float *)((char *)p + f->off);
}

static int *int_at(struct sp1_prst *p, const struct sp1_prst_field *f)
{
	return (int *)((char *)p + f->off);
}

/* ---- defaults ---- */
void sp1_prst_rip(struct sp1_prst *p, int slot)
{
	memset(p, 0, sizeof(*p));
	sp1_pui_rip_patch(slot, &p->plaits);
	sp1_mui_rip_patch(&p->marbles);
	p->out_mode = SP1_PRST_DEF_OUT;
	p->burst_div = (int)SP1_PRST_DEF_BURST;
	p->drive = SP1_PRST_DEF_DRIVE;
}

/* ---- writing ---- */
int sp1_prst_write(const struct sp1_prst *p, char *buf, size_t size)
{
	size_t at = 0;
	const char *section = "";
	int n = snprintf(buf, size, "; Wakes preset (PRST). A value Wakes cannot read loads "
				    "its default.\n[wakes]\nformat = %d\n", SP1_PRST_FORMAT);
	if (n < 0 || (size_t)n >= size) {
		return -1;
	}
	at = (size_t)n;
	for (int i = 0; i < SP1_PRST_NFIELDS; i++) {
		const struct sp1_prst_field *f = &SP1_PRST_FIELDS[i];
		struct sp1_prst *const q = (struct sp1_prst *)p;    /* read only */
		if (strcmp(section, f->section) != 0) {
			section = f->section;
			n = snprintf(buf + at, size - at, "\n[%s]\n", section);
			if (n < 0 || (size_t)n >= size - at) {
				return -1;
			}
			at += (size_t)n;
		}
		if (f->kind == SP1_PRST_K_POS) {
			float v = *pos_at(q, f);
			v = isfinite(v) ? (v < 0.0f ? 0.0f : (v > 1.0f ? 1.0f : v)) : 0.0f;
			const int k = (int)(v * 10000.0f + 0.5f);
			n = snprintf(buf + at, size - at, "%s = %d.%04d\n", f->key, k / 10000,
				     k % 10000);
		} else if (f->kind == SP1_PRST_K_ENGINE) {
			n = snprintf(buf + at, size - at, "%s = %s\n", f->key,
				     sp1_pui_slot_name(*int_at(q, f)));
		} else {
			const int v = *int_at(q, f);
			const char *tok = NULL;
			for (int c = 0; c < f->n_ch; c++) {
				if (f->ch[c].val == v) {
					tok = f->ch[c].tok;
					break;
				}
			}
			if (tok == NULL) {
				continue;       /* not representable: left out, so it loads its default */
			}
			n = snprintf(buf + at, size - at, "%s = %s\n", f->key, tok);
		}
		if (n < 0 || (size_t)n >= size - at) {
			return -1;
		}
		at += (size_t)n;
	}
	return (int)at;
}

/* ---- reading ---- */

/* A fader value: a plain decimal number in 0..1 -- digits, at most one point, nothing else.
 * No sign, no exponent, no "nan" or "inf": anything strtof would accept beyond that is a
 * value no Wakes ever wrote, so it is treated as corrupt rather than guessed at. */
static bool parse_pos(struct span s, float *out)
{
	int i = 0, idig = 0, fdig = 0;
	uint32_t ip = 0u, fnum = 0u, fden = 1u;
	while (i < s.n && s.p[i] >= '0' && s.p[i] <= '9') {
		if (idig < 3) {
			ip = ip * 10u + (uint32_t)(s.p[i] - '0');
		}
		idig++;
		i++;
	}
	if (i < s.n && s.p[i] == '.') {
		i++;
		while (i < s.n && s.p[i] >= '0' && s.p[i] <= '9') {
			if (fdig < 8) {
				fnum = fnum * 10u + (uint32_t)(s.p[i] - '0');
				fden *= 10u;
			}
			fdig++;
			i++;
		}
	}
	if (i != s.n || idig + fdig == 0 || idig > 3) {
		return false;
	}
	const float v = (float)ip + (float)fnum / (float)fden;
	if (!(v >= 0.0f && v <= 1.0f)) {
		return false;
	}
	*out = v;
	return true;
}

static bool check_ok(uint8_t check, int v)
{
	switch (check) {
	case SP1_PRST_C_SCALE:  return v == SP1_PUI_SCALE_OFF || sp1_mui_scale_included(v);
	case SP1_PRST_C_T_DEST: return sp1_mui_dest_allowed(true, v);
	case SP1_PRST_C_X_DEST: return sp1_mui_dest_allowed(false, v);
	default:                return true;
	}
}

static bool parse_choice(const struct sp1_prst_field *f, struct span s, int *out)
{
	for (int c = 0; c < f->n_ch; c++) {
		if (eq(s, f->ch[c].tok)) {
			if (!check_ok(f->check, f->ch[c].val)) {
				return false;
			}
			*out = f->ch[c].val;
			return true;
		}
	}
	return false;
}

/* A format number: plain digits only. -1 = not one. */
static int parse_format(struct span s)
{
	if (s.n < 1 || s.n > 6) {
		return -1;
	}
	int v = 0;
	for (int i = 0; i < s.n; i++) {
		if (s.p[i] < '0' || s.p[i] > '9') {
			return -1;
		}
		v = v * 10 + (s.p[i] - '0');
	}
	return v;
}

void sp1_prst_parse(const char *text, size_t len, struct sp1_prst *out,
		    struct sp1_prst_report *rep)
{
	struct span val[SP1_PRST_NFIELDS];
	bool have[SP1_PRST_NFIELDS] = { false };
	struct span fmt = { NULL, 0 };
	bool have_fmt = false;
	struct span section = { NULL, -1 };    /* -1: before any section, or a broken one */

	rep->format = -1;
	rep->format_ok = false;
	rep->defaulted = 0;
	rep->bad = 0;
	rep->first_bad = NULL;

	/* ---- one pass: remember the LAST value seen for every known key ---- */
	size_t at = 0;
	while (text != NULL && at < len) {
		size_t end = at;
		while (end < len && text[end] != '\n') {
			end++;
		}
		const struct span line = trim(text + at, (int)(end - at));
		at = end + 1u;
		if (line.n == 0 || line.p[0] == ';' || line.p[0] == '#') {
			continue;
		}
		if (line.p[0] == '[') {
			section = (line.n >= 2 && line.p[line.n - 1] == ']')
				? trim(line.p + 1, line.n - 2) : (struct span){ NULL, -1 };
			continue;
		}
		int eqat = 0;
		while (eqat < line.n && line.p[eqat] != '=') {
			eqat++;
		}
		if (eqat == line.n || section.n < 0) {
			continue;
		}
		const struct span key = trim(line.p, eqat);
		const struct span v = trim(line.p + eqat + 1, line.n - eqat - 1);
		if (eq(section, "wakes") && eq(key, "format")) {
			fmt = v;
			have_fmt = true;
			continue;
		}
		for (int i = 0; i < SP1_PRST_NFIELDS; i++) {
			if (eq(section, SP1_PRST_FIELDS[i].section) &&
			    eq(key, SP1_PRST_FIELDS[i].key)) {
				val[i] = v;
				have[i] = true;
				break;
			}
		}
	}

	/* ---- a format this firmware does not know: the whole slot is the defaults ---- */
	rep->format = have_fmt ? parse_format(fmt) : -1;
	if (rep->format != SP1_PRST_FORMAT) {
		sp1_prst_rip(out, -1);
		rep->defaulted = SP1_PRST_NFIELDS;
		return;
	}
	rep->format_ok = true;

	/* ---- the engine first: a bad BASE fader takes ITS neutral value ---- */
	int slot = -1;
	for (int i = 0; i < SP1_PRST_NFIELDS; i++) {
		if (SP1_PRST_FIELDS[i].kind != SP1_PRST_K_ENGINE) {
			continue;
		}
		if (have[i]) {
			slot = sp1_pui_slot_of(val[i].p, val[i].n);
			if (slot < 0) {
				rep->bad++;
				rep->first_bad = SP1_PRST_FIELDS[i].key;
			}
		}
		if (slot < 0) {
			rep->defaulted++;
		}
	}
	sp1_prst_rip(out, slot);     /* every default, the neutral BASE of that engine */

	/* ---- every other field on its own ---- */
	for (int i = 0; i < SP1_PRST_NFIELDS; i++) {
		const struct sp1_prst_field *f = &SP1_PRST_FIELDS[i];
		if (f->kind == SP1_PRST_K_ENGINE) {
			continue;
		}
		if (!have[i]) {
			rep->defaulted++;
			continue;
		}
		bool ok;
		if (f->kind == SP1_PRST_K_POS) {
			float v;
			ok = parse_pos(val[i], &v);
			if (ok) {
				*pos_at(out, f) = v;
			}
		} else {
			int v;
			ok = parse_choice(f, val[i], &v);
			if (ok) {
				*int_at(out, f) = v;
			}
		}
		if (!ok) {
			rep->defaulted++;
			rep->bad++;
			if (rep->first_bad == NULL) {
				rep->first_bad = f->key;
			}
		}
	}
}

int sp1_prst_fields(void)
{
	return SP1_PRST_NFIELDS;
}
